## sdkconfig.defaults
```kconfig
CONFIG_SPIRAM=n
# Bluetooth (NimBLE)
CONFIG_BT_ENABLED=y
CONFIG_BT_NIMBLE_ENABLED=y
CONFIG_BT_CONTROLLER_ONLY=n
CONFIG_BT_BLUEDROID_ENABLED=n
CONFIG_BT_BLE_50_FEATURES_SUPPORTED=y
CONFIG_BT_NIMBLE_MAX_CONNECTIONS=1
CONFIG_BT_NIMBLE_MAX_BONDS=0
CONFIG_BT_NIMBLE_MESH=n
CONFIG_BT_ACL_CONNECTIONS=1
CONFIG_BT_ALLOCATION_FROM_SPIRAM_FIRST=n
CONFIG_BT_BLE_HOST_QUEUE_CONG_CHECK=n
CONFIG_BT_NIMBLE_HOST_BASED_ON_CONTROLLER_RPA=n
CONFIG_BT_NIMBLE_ROLE_CENTRAL=n
CONFIG_BT_NIMBLE_ROLE_PERIPHERAL=y
CONFIG_BT_NIMBLE_ROLE_BROADCASTER=y
CONFIG_BT_NIMBLE_ROLE_OBSERVER=n
CONFIG_BT_NIMBLE_HS_STOP_TIMEOUT_MS=2000
CONFIG_BT_NIMBLE_ATT_PREFERRED_MTU=256
CONFIG_BT_NIMBLE_L2CAP_COC_MAX_NUM=0
CONFIG_BT_NIMBLE_PINNED_TO_CORE=0
CONFIG_BT_NIMBLE_TASK_STACK_SIZE=4096
CONFIG_BT_NIMBLE_CRYPTO_STACK_MBEDTLS=y
# Partition table (large single app for BT+WiFi+TFLM coexistence)
CONFIG_PARTITION_TABLE_SINGLE_APP_LARGE=y
```
